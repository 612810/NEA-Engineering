/* This program was written by David Humphries for NEA Engineering:
 Anjali Pal
 Elyssa Snively
 Natalie Salema
 */

#include <Wire.h>
#include <Adafruit_GFX.h>
#include <Adafruit_SSD1306.h>
#include <Fonts/FreeSerif9pt7b.h>
#include <Fonts/FreeSerif12pt7b.h>

int bluePin = 2;    //IN1 on the ULN2003 Board, BLUE end of the Blue/Yellow motor coil
int pinkPin = 3;    //IN2 on the ULN2003 Board, PINK end of the Pink/Orange motor coil
int yellowPin = 4;  //IN3 on the ULN2003 Board, YELLOW end of the Blue/Yellow motor coil
int orangePin = 5;  //IN4 on the ULN2003 Board, ORANGE end of the Pink/Orange motor coil
int oneunit = 48;   //number of times through the loop (steps) to dispense one unit
int dose = 0;       //the number of units the patient requests 
int total_dose = 0;   //counts the total dose
int dose_switch = 9;
int confirm_switch = 10;
int confirm = 0;

#define SCREEN_WIDTH 128
#define SCREEN_HEIGHT 64

Adafruit_SSD1306 display(SCREEN_WIDTH, SCREEN_HEIGHT, &Wire, -1);

static const unsigned char PROGMEM image_data_CATACat[] = {   
    0xff, 0xff, 0xff, 0xff, 0xff, 0xff, 0xff, 0xff, 0xff, 0xff, 0xff, 0xff, 0xff, 0xff, 0xff, 0xff, 
    0xff, 0xff, 0xff, 0xff, 0xff, 0xff, 0xff, 0xff, 0xff, 0xff, 0xff, 0xff, 0xff, 0xff, 0xff, 0xff, 
    0xff, 0xff, 0xff, 0xff, 0xff, 0xff, 0xff, 0xff, 0xff, 0xff, 0xff, 0xff, 0xff, 0xff, 0xff, 0xff, 
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    0xff, 0xff, 0xff, 0xff, 0xff, 0xff, 0xff, 0xff, 0xff, 0xff, 0xff, 0xff, 0xff, 0xff, 0xff, 0xff
};  


void setup() {  
 Serial.begin(9600);  

  if(!display.begin(SSD1306_SWITCHCAPVCC, 0x3C)) {
    Serial.println(F("SSD1306 allocation failed"));
    for(;;);
  }
  
  pinMode(bluePin, OUTPUT);
  pinMode(pinkPin, OUTPUT);
  pinMode(yellowPin, OUTPUT);
  pinMode(orangePin,OUTPUT);
  pinMode(dose_switch, INPUT);
  pinMode(confirm_switch, INPUT);

  // Draw bitmap on the screen
  display.clearDisplay();
  display.drawBitmap(0, 0, image_data_CATACat, 128, 64, 1);
  //display.startscrollright(0x00, 0x0F);
  display.display();
  delay(2000);
  
  // Display static text
  display.clearDisplay();  
  display.setFont();
  display.setTextSize(1);             
  display.setTextColor(WHITE);
  display.setCursor(20,5);
  display.println("NEA ENGINEERING");
  //display.display();    
  display.setCursor(15,26);
  display.setFont(&FreeSerif12pt7b);    
  display.println("INSULIN");
  display.setCursor(30,54);
  display.setFont(&FreeSerif12pt7b);    
  display.println("PUMP");
  display.display();
  delay(2000); 
  
  digitalWrite(bluePin, LOW);
  digitalWrite(pinkPin, LOW);
  digitalWrite(yellowPin, LOW);
  digitalWrite(orangePin, LOW);
  
}

void loop() {

  display.clearDisplay();  
  display.setFont();
  display.setTextSize(1);             
  display.setTextColor(WHITE);
  display.setCursor(20,5);
  display.println("NEA ENGINEERING");
  //display.display();    
  display.setCursor(12,26);
  display.setFont(&FreeSerif12pt7b);    
  display.println("SET DOSE");
  display.setCursor(55,54);
  display.setFont(&FreeSerif12pt7b);    
  display.println(dose);
  display.display();

  while (digitalRead(confirm_switch) == HIGH && digitalRead(dose_switch) == HIGH){
   dose = 0;
      digitalWrite(bluePin, LOW);
      digitalWrite(pinkPin, LOW);
      digitalWrite(yellowPin, LOW);
      digitalWrite(orangePin, HIGH);
      delay(5);
     
      digitalWrite(bluePin, LOW);
      digitalWrite(pinkPin, LOW);
      digitalWrite(yellowPin, HIGH);
      digitalWrite(orangePin, LOW);
      delay(5);
      
      digitalWrite(bluePin, LOW);
      digitalWrite(pinkPin, HIGH);
      digitalWrite(yellowPin, LOW);
      digitalWrite(orangePin, LOW);
      delay(5);
      
      digitalWrite(bluePin, HIGH);
      digitalWrite(pinkPin, LOW);
      digitalWrite(yellowPin, LOW);
      digitalWrite(orangePin, LOW);
      delay(5); 
  }

  if (digitalRead(confirm_switch) == LOW && digitalRead(dose_switch) == HIGH){
    dose++;
    delay(300);
  }
  else if (digitalRead(confirm_switch) == HIGH && digitalRead(dose_switch) == LOW){
    total_dose = dose*oneunit;
   while (total_dose != 0){
      dose = 0;
      digitalWrite(bluePin, HIGH);
      digitalWrite(pinkPin, LOW);
      digitalWrite(yellowPin, LOW);
      digitalWrite(orangePin, LOW);
      delay(5);
     
      digitalWrite(bluePin, LOW);
      digitalWrite(pinkPin, HIGH);
      digitalWrite(yellowPin, LOW);
      digitalWrite(orangePin, LOW);
      delay(5);
      
      digitalWrite(bluePin, LOW);
      digitalWrite(pinkPin, LOW);
      digitalWrite(yellowPin, HIGH);
      digitalWrite(orangePin, LOW);
      delay(5);
      
      digitalWrite(bluePin, LOW);
      digitalWrite(pinkPin, LOW);
      digitalWrite(yellowPin, LOW);
      digitalWrite(orangePin, HIGH);
      delay(5);
      
      total_dose--;
      }
     }
      else {
      }
    }

  
